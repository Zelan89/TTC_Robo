## components/tcp_server/Kconfig
```kconfig
menu "Server Configuration"

choice IP_MODE
    prompt "IP Version"
    help
       Server can use either IPV4 or IPV6.

config IPV4
    bool "IPV4"

config IPV6
   bool "IPV6"
   select LWIP_IPV6

endchoice

config SERVER_PORT
    int "Port"
    range 0 65535
    default 3333
    help
        Local port the server will listen on.

endmenu
```
